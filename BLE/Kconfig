## BLE/Kconfig
```kconfig
menu "AGCORE BLE CONFIG"

config AGCORE_BLE_ENABLE
    bool "Enable AGCORE BLE transport"
    default y
    depends on !APP_NO_BLOBS
    select BT_ENABLED
    select BT_NIMBLE_ENABLED
    select BT_CONTROLLER_ENABLED if SOC_BT_SUPPORTED
    help
        Enable AGCORE BLE transport and select ESP-IDF Bluetooth NimBLE support.

config AGCORE_BLE_ADV_ITVL_MIN_MS
    int "BLE advertising min interval(ms)"
    default 100
    depends on AGCORE_BLE_ENABLE

config AGCORE_BLE_ADV_ITVL_MAX_MS
    int "BLE advertising max interval(ms)"
    default 200
    depends on AGCORE_BLE_ENABLE

endmenu
```

## DisplayDriver/Kconfig
```kconfig
menu "DisPlay Driver Configuration"

config DISPLAY_DRIVER_ENABLE
    bool "Enable DisPlay Driver"
    default n

choice DISPLAY_IC_TYPE
    prompt "DisPlay IC Type"
    default DISPLAY_IC_ST7735
    depends on DISPLAY_DRIVER_ENABLE

config DISPLAY_IC_ST7735
    bool "ST7735"

endchoice

if DISPLAY_IC_ST7735
rsource "display7735/display7735_kconfig"
endif

endmenu
```

## PrintfLog/Kconfig
```kconfig
menu "Printf Log Configuration"

config AGCORE_CORELOG_LEVEL
    int "Core Log Level"
    default 2
    range 0 4

config AGCORE_APPLOG_LEVEL
    int "App Log Level"
    default 2
    range 0 4

endmenu
```

## pixel_driver/Kconfig
```kconfig
menu "Pixel Driver Configuration"

config PIXEL_DRIVER_ENABLE
    bool "Enable Pixel Driver"
    default n

choice PIXEL_TYPE
    prompt "Pixel Type"
    default PIXEL_TYPE_WS2812B_RMT
    depends on PIXEL_DRIVER_ENABLE

config PIXEL_TYPE_WS2812B_SPI
    bool "WS2812B (SPI)"

config PIXEL_TYPE_WS2812B_RMT
    bool "WS2812B (RMT)"

config PIXEL_TYPE_SK6812
    bool "SK6812"

endchoice

config WS2812B_STACK_SIZE
    int "WS2812B Task Stack Size (bytes)"
    default 1024
    range 256 8192
    depends on PIXEL_DRIVER_ENABLE && (PIXEL_TYPE_WS2812B_SPI || PIXEL_TYPE_WS2812B_RMT)

config ARGB_OUT_PIN
    int "ARGB Output Pin"
    default 2
    range 0 39
    depends on PIXEL_DRIVER_ENABLE

config LED_COUNT_MAX
    int "LED Count Max"
    default 1024
    range 1 4096
    depends on PIXEL_DRIVER_ENABLE

config DEFAULT_LED_NUM
    int "Default LED Count"
    default 100
    range 1 LED_COUNT_MAX
    depends on PIXEL_DRIVER_ENABLE

endmenu
```
