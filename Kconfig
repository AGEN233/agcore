## Kconfig
```kconfig
menu "AGCORE CONFIG"

rsource "transport/ble/Kconfig"
rsource "common/console/Kconfig"
rsource "common/lifecycle/Kconfig"
rsource "common/persist/Kconfig"
rsource "driver/pixel/Kconfig"
rsource "driver/display/Kconfig"

endmenu
```

## common/console/Kconfig
```kconfig
menu "Console"

    config AGCORE_CORELOG_LEVEL
        int "Core Log Level"
        default 3
        range 0 4

    config AGCORE_APPLOG_LEVEL
        int "App Log Level"
        default 4
        range 0 4

    config AGCORE_CONSOLE_LOG_LINE_BUF_SIZE
        int "Log Line Buffer Size"
        default 512
        range 128 4096

    config AGCORE_CONSOLE_SHELL_ENABLE
        bool "Enable AGCORE Shell"
        default y

    config AGCORE_CONSOLE_SHELL_BUF_SIZE
        int "Shell Buffer Size"
        default 512
        range 128 4096
        depends on AGCORE_CONSOLE_SHELL_ENABLE
endmenu
```

## common/lifecycle/Kconfig
```kconfig
menu "LifeCycle"

config AGCORE_LIFECYCLE_FACTORY_BOOT_COUNT
    int "Factory reset trigger boot count"
    default 5
    range 2 20

config AGCORE_LIFECYCLE_STABLE_CLEAR_MS
    int "Boot stable clear time ms"
    default 10000
    range 1000 60000

endmenu
```

## common/persist/Kconfig
```kconfig
menu "AGCORE PERSIST"

config AGCORE_FLASH_PARTITION_LABEL
    string "Flash partition label"
    default "data"
    help
        Partition label used by agcore_flash_* APIs.

config AGCORE_FS_ENABLE
    bool "Enable filesystem support"
    default n

config AGCORE_FS_PARTITION_LABEL
    string "Filesystem partition label"
    default "fs"
    depends on AGCORE_FS_ENABLE
    help
        Partition label mounted by agcore_fs_* APIs.

endmenu
```

## console/log/Kconfig
```kconfig
menu "Printf Log Configuration"

config AGCORE_CORELOG_LEVEL
    int "Core Log Level"
    default 3
    range 0 4

config AGCORE_APPLOG_LEVEL
    int "App Log Level"
    default 4
    range 0 4

endmenu
```

## console/shell/Kconfig
```kconfig
menu "Shell Configuration"

# 待 esh 接入后在此添加配置项
# config AGCORE_SHELL_ENABLE
#     bool "Enable esh shell"
#     default n

endmenu
```

## driver/display/Kconfig
```kconfig
menu "DisPlay Driver Configuration"

config DISPLAY_DRIVER_ENABLE
    bool "Enable DisPlay Driver"
    default n

choice DISPLAY_IC_TYPE
    prompt "DisPlay IC Type"
    default DISPLAY_IC_ST7735
    depends on DISPLAY_DRIVER_ENABLE

config DISPLAY_IC_ST7735
    bool "ST7735"

config DISPLAY_IC_ST7789
    bool "ST7789"

endchoice

if DISPLAY_IC_ST7735
rsource "panel/st7735/Kconfig"

endif

if DISPLAY_IC_ST7789
rsource "panel/st7789/Kconfig"

endif

endmenu
```

## pipe/transport/ble/Kconfig
```kconfig
menu "AGCORE BLE CONFIG"

config AGCORE_BLE_ENABLE
    bool "Enable AGCORE BLE transport"
    default y
    depends on !APP_NO_BLOBS
    select BT_ENABLED
    select BT_NIMBLE_ENABLED
    select BT_CONTROLLER_ENABLED if SOC_BT_SUPPORTED
    help
        Enable AGCORE BLE transport and select ESP-IDF Bluetooth NimBLE support.

config AGCORE_BLE_ADV_ITVL_MIN_MS
    int "BLE advertising min interval(ms)"
    default 100
    depends on AGCORE_BLE_ENABLE

config AGCORE_BLE_ADV_ITVL_MAX_MS
    int "BLE advertising max interval(ms)"
    default 200
    depends on AGCORE_BLE_ENABLE

config AGCORE_BLE_MESSAGE_MAX_LEN
    int "Maximum reassembled BLE message length"
    range 1 65535
    default 4096
    depends on AGCORE_BLE_ENABLE
    help
        Limit the complete protocol message length, excluding the fragment header.

config AGCORE_BLE_FRAGMENT_TIMEOUT_MS
    int "BLE fragment receive idle timeout(ms)"
    range 100 60000
    default 5000
    depends on AGCORE_BLE_ENABLE
    help
        Release an incomplete message if no valid continuation arrives in time.

endmenu
```
